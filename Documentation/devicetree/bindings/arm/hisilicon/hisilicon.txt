## Documentation/devicetree/bindings/net/hisilicon-hi1382-gmac.txt
```
Hisilicon hi1382 Ethernet Controller

* Ethernet controller node

Required properties:
- compatible: should be "hisilicon,hi1382-gmac".
- reg: address and length of the register set for the device.
	first record is the eth sub sysctrl base addr.
	second record is the ppe base addr.
	third record is the GEx base addr.
- interrupts: interrupt for the device.
- port-id: <GEX>
	different platform the GE is different.
	on EVB the GE is 0x4.
	on UMPTE the GE is 0x4.
	on UBPPE the GE is 0x3.
- phy-mode: see ethernet.txt [1].

Optional properties:
- phy-handle: see ethernet.txt [1].
	on EVB the phy is 24.
	on UMPTE the phy is 8.
	on UBPPE there is no phy.
- phy-id: to identify which is use phy or i2c.
	on EVB the phy is bcm54219 the id is 0x600d8590.
	son UBPPE use I2C.

[1] Documentation/devicetree/bindings/net/ethernet.txt


Control rx & tx fifos of all ethernet controllers.
Have 2048 recv channels shared by all ethernet controllers, only if no overlap.
For the Hi1382 Gmac start form 1791. the lenth is 255. (while the max is 256).

* MDIO bus node:

Required properties:

- compatible: should be "hisilicon,hi1382-mdio".
- Inherits from MDIO bus node binding [2]
[2] Documentation/devicetree/bindings/net/phy.txt

Example:

in 1382.dtsi:
	mdio {
		compatible = "hisilicon,hi1382-mdio";
		reg = <0x28f1000 0x1000>;
		#address-cells = <1>;
		#size-cells = <0>;

		phy0: ethernet-phy@0 {
			compatible = "ethernet-phy-ieee802.3-c22";
			reg = <0>;
			max-speed = <100>;
		};
	};


	gmac0: gmac@fb800000 {
		compatible = "hisilicon,hi1382-gmac";
		#address-cells = <1>;
		#size-cells = <0>;
		phy-mode = "sgmii";
		interrupt-parent = <&mbigen_eth>;
		interrupts = <0x10800 33 0 5 >,
			     <0x10800 33 1 5 >,
			     <0x10800 33 2 5 >,
			     <0x10800 33 3 5 >,
			     <0x10800 33 4 5 >,
			     <0x10800 33 5 5 >,
			     <0x10800 33 6 5 >,
			     <0x10800 33 7 5 >,
			     <0x10800 33 8 5 >,
			     <0x10800 33 9 5 >,
			     <0x10800 33 10 5 >,
			     <0x10800 33 11 5 >,
			     <0x10800 33 12 5 >,
			     <0x10800 33 13 5 >,
			     <0x10800 33 14 5 >,
			     <0x10800 33 15 5 >,
			     <0x10800 33 16 5 >,
			     <0x10800 33 17 5 >,
			     <0x10800 33 18 5 >,
			     <0x10800 33 19 5 >,
			     <0x10800 33 20 5 >,
			     <0x10800 33 21 5 >,
			     <0x10800 33 22 5 >,
			     <0x10800 33 23 5 >,
			     <0x10800 33 24 5 >,
			     <0x10800 33 25 5 >,
			     <0x10800 33 26 5 >,
			     <0x10800 33 27 5 >,
			     <0x10800 33 28 5 >,
			     <0x10800 33 29 5 >,
			     <0x10800 33 30 5 >,
			     <0x10800 33 31 5 >,
			     <0x10800 33 32 5 >;
	};

in hi1382-evb.dts

	gmac0: gmac@fb800000 {
		phy-handle = <&phy24>;
		port-id = <4>;
		phy-id = <0x600d8590>;
		reg = <0xfb000000 0x10000>,
		      <0xfb400000 0x30000>,
		      <0xfb804000 0x1000>;
	};
```

## Documentation/devicetree/bindings/net/hisilicon-hns-mdio.txt
```
Hisilicon MDIO bus controller

* sub controller node

Required properties:
- compatible:
	"hisilicon,peri-c-subctrl","syscon" if mdio connects to sub-ctrl
	"hisilicon,io-wrap-ctrl","syscon" if mdio connects to io-wrap-ctrl
- reg: address and length of the register set for the device.

Properties:
- compatible: can be one of:
	"hisilicon,hi1382-mdio"
	"hisilicon,hi1616-mdio"
	"hisilicon,hns-mdio"
	"hisilicon,mdio"
  "hisilicon,hns-mdio" is recommended to be used for hip05 and later SOCs,
  while "hisilicon,mdio" is optional for backwards compatibility only on
  hip04 Soc.
- reg: The base address of the MDIO bus controller register bank.
- subctrl_vbase: sub control base addr
- #address-cells: Must be <1>.
- #size-cells: Must be <0>.  MDIO addresses have no size component.

Typically an MDIO bus might have several children.

Example:
	mdio@803c0000 {
		#address-cells = <1>;
		#size-cells = <0>;
		compatible = "hisilicon,mdio","hisilicon,hns-mdio";
		reg = <0x0 0x803c0000 0x0 0x10000>;
		subctrl_vbase = <&peri_c_subctrl>;
		ethernet-phy@0 {
			...
			reg = <0>;
		};
	};
```

## Documentation/devicetree/bindings/pci/hisilicon-pcie.txt
```
HiSilicon PCIe host bridge DT description

HiSilicon PCIe host controller is based on Designware PCI core.
It shares common functions with PCIe Designware core driver and inherits
common properties defined in
Documentation/devicetree/bindings/pci/designware-pci.txt.

Additional properties are described here:

Required properties:
- compatible: Should contain "hisilicon,hip05-pcie".
- reg: Should contain rc_dbi, subctrl, config registers location and length.
- reg-names: Must include the following entries:
  "rc_dbi": controller configuration registers;
  "subctrl": whole PCIe hosts configuration registers;
  "pcs": pcs configuration registers;
  "config": PCIe configuration space registers;
  "serdes": serdes configuration registers.
- msi-parent: Should be its_pcie which is an ITS receiving MSI interrupts.
- port-id: Should be 0, 1, 2 or 3.

Optional properties:
- status: Either "ok" or "disabled".
- dma-coherent: Present if DMA operations are coherent.
- smmu_ro: For "1" indicating set smmu relax order mode, for "0" not set the mode.

Example:
	pcie@0xb0080000 {
		compatible = "hisilicon,hip05-pcie", "snps,dw-pcie";
		reg = <0 0xb0080000 0 0x10000>, <0 0xb0000000 0 0x10000>,
		      <0 0xb00d0000 0 0x10000>, <0x220 0x00000000 0 0x2000>,
		      <0 0xb2000000 0 0x40000>;
		reg-names = "rc_dbi", "subctrl", "pcs", "config", "serdes";
		bus-range = <0  15>;
		msi-parent = <&its_pcie>;
		#address-cells = <3>;
		#size-cells = <2>;
		device_type = "pci";
		dma-coherent;
		ranges = <0x82000000 0 0xb0000000 0x220 0x00020000 0 0x10000000>,
			<0x01000000 0 0 0x220 0x00010000 0 0x10000 >;
		num-lanes = <8>;
		port-id = <1>;
		#interrupts-cells = <1>;
		interrupts-map-mask = <0xf800 0 0 7>;
		interrupts-map = <0x0 0 0 1 &mbigen_pcie 1 10
				  0x0 0 0 2 &mbigen_pcie 2 11
				  0x0 0 0 3 &mbigen_pcie 3 12
				  0x0 0 0 4 &mbigen_pcie 4 13>;
		smmu_ro = <1>;
		status = "ok";
	};
```

## drivers/misc/hisi-djtag/Kconfig
```kconfig
config HISI_DJTAG
        bool "hisilicon djtag r/w interface via syscon"
	depends on ARM64 || COMPILE_TEST
        help
          This enables support djtag r/w for some modules.
```
