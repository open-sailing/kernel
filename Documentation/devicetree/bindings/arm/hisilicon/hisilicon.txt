## Documentation/devicetree/bindings/arm/hisilicon/hisilicon.txt
```
Hisilicon Platforms Device Tree Bindings
----------------------------------------------------

Hi4511 Board
Required root node properties:
	- compatible = "hisilicon,hi3620-hi4511";

HiP04 D01 Board
Required root node properties:
	- compatible = "hisilicon,hip04-d01";

HiP01 ca9x2 Board
Required root node properties:
	- compatible = "hisilicon,hip01-ca9x2";


Hisilicon system controller

Required properties:
- compatible : "hisilicon,sysctrl"
- reg : Register address and size

Optional properties:
- smp-offset : offset in sysctrl for notifying slave cpu booting
		cpu 1, reg;
		cpu 2, reg + 0x4;
		cpu 3, reg + 0x8;
		If reg value is not zero, cpun exit wfi and go
- resume-offset : offset in sysctrl for notifying cpu0 when resume
- reboot-offset : offset in sysctrl for system reboot

Example:

	/* for Hi3620 */
	sysctrl: system-controller@fc802000 {
		compatible = "hisilicon,sysctrl";
		reg = <0xfc802000 0x1000>;
		smp-offset = <0x31c>;
		resume-offset = <0x308>;
		reboot-offset = <0x4>;
	};

-----------------------------------------------------------------------
Hisilicon HiP01 system controller

Required properties:
- compatible : "hisilicon,hip01-sysctrl"
- reg : Register address and size

The HiP01 system controller is mostly compatible with hisilicon
system controller,but it has some specific control registers for
HIP01 SoC family, such as slave core boot, and also some same
registers located at different offset.

Example:

	/* for hip01-ca9x2 */
	sysctrl: system-controller@10000000 {
		compatible = "hisilicon,hip01-sysctrl", "hisilicon,sysctrl";
		reg = <0x10000000 0x1000>;
		reboot-offset = <0x4>;
	};

-----------------------------------------------------------------------
Hisilicon CPU controller

Required properties:
- compatible : "hisilicon,cpuctrl"
- reg : Register address and size

The clock registers and power registers of secondary cores are defined
in CPU controller, especially in HIX5HD2 SoC.

-----------------------------------------------------------------------
PCTRL: Peripheral misc control register

Required Properties:
- compatible: "hisilicon,pctrl"
- reg: Address and size of pctrl.

Example:

	/* for Hi3620 */
	pctrl: pctrl@fca09000 {
		compatible = "hisilicon,pctrl";
		reg = <0xfca09000 0x1000>;
	};

-----------------------------------------------------------------------
Fabric:

Required Properties:
- compatible: "hisilicon,hip04-fabric";
- reg: Address and size of Fabric

-----------------------------------------------------------------------
Bootwrapper boot method (software protocol on SMP):

Required Properties:
- compatible: "hisilicon,hip04-bootwrapper";
- boot-method: Address and size of boot method.
  [0]: bootwrapper physical address
  [1]: bootwrapper size
  [2]: relocation physical address
  [3]: relocation size

-----------------------------------------------------------------------
Hisilicon djtag r/w driver
djtag:
Required Properties:
- compatible	    : Should include "hisilicon,hip05-djtag"
		      or "hisilicon,hi1382-djtag"
- syscon	    : implement r/w interfaces via which sysctrl node.
- djtag-mutex-access-protection	: Present if djtag need add mutex access
				  protection to fix conflict with firmware
				  (like M3).

Hisilicon L3 Cache Controller

LLC(Last Level cache) is an alias of L3 cache, It is present in Hisilicon P660,
Hi1610 and Hi1382 platforms. It has has no private space for register r/w, so
we need to do register r/w via djtag of sysctrl.

llc:
Required Properties:
- compatible        : Should include "hisilicon,hip05-llc"
		      or "hisilicon,hi1382-llc"
- djtag		    : which djtag node and its CPU die ID.
		      The first region is the djtag node name.
		      The second region is the CPU die ID of the djtag.
		      /* socket 0: A die = 1; C die = 2; B die = 3; */
		      /* socket 1: A die = 5; C die = 6; B die = 7; */

Example:
	/* If it have multi dies, set like below.
	 *
	 * We need sysctrl node for its register address and "syscon",
	 * but we don't implement sysctrl driver and don't care about
	 * what compatible it is. So this example use "hisilicon,xxx".
	 */

for Hisilicon P660(hip05) or Hi1610:
	pa_sysctrl: system-controller@40010000 {
	        compatible = "hisilicon,xxx", "syscon";
	        reg = <0x40010000 0x10000>;
	};

	pc_sysctrl: system-controller@60010000 {
	        compatible = "hisilicon,xxx", "syscon";
	        reg = <0x60010000 0x10000>;
	};

	djtag0: djtag@0 {
		compatible = "hisilicon,hip05-djtag";
		syscon = <&pa_sysctrl>;
	};

	djtag1: djtag@1 {
		compatible = "hisilicon,hip05-djtag";
		syscon = <&pc_sysctrl>;
	};

	llc0: llc@0 {
	        compatible = "hisilicon,hip05-llc";
		djtag = <&djtag0 1>;
	};

	llc1: llc@1 {
	        compatible = "hisilicon,hip05-llc";
		djtag = <&djtag1 2>;
	};

for Hisilicon Hi1382(hi1382):
	pc_sysctrl: system-controller@f1010000 {
		compatible = "hisilicon,xxx", "syscon";
		reg = <0xf1010000 0x10000>;
	};

	djtag0: djtag@0 {
		compatible = "hisilicon,hi1382-djtag";
		syscon = <&pc_sysctrl>;
	};

	llc0: llc@0{
	      compatible = "hisilicon,hi1382-llc";
	      djtag = <&djtag0 2>;
	};
```

## Documentation/devicetree/bindings/bus/hisilicon-lpc.txt
```
Hisilicon Low Pin Count bus

Required properties
- compatible: "hisilicon,low-pin-count"
- reg specifies low pin count address range

Example:
	lpc_0: lpc@a01b0000 {
		compatible = "hisilicon,low-pin-count";
		ret = <0x0 0xa01b0000, 0x0, 0x10000>;
	};
```

## Documentation/devicetree/bindings/edac/hisi-hip05-edac.txt
```
Hisi hip05 SoC EDAC node

EDAC node is defined to describe on-chip error detection and correction.
The follow error types are supported:

  memory controller	- Memory controller
  cache (L1/L2)	- Processor L1/L2 cache

The following section describes the EDAC DT node binding.

Required properties:

 compatible		: Shall be "hisi,hip05-edac-cache".
  - poll-delay-ms	: ms of delay to poll cache ECC

Example:

edaccache {
	compatible = "hisi,hip05-edac-cache";
	poll-delay-ms = <1000>;
}


Hisi DDR3/4 DRAM Controller EDAC node

EDAC node is defined to describe on-chip error detection and correction of
Hisi DDR3/4 DRAM Controller.

The follow error types are supported:

  DDR3/4 DRAM Controller	- DRAM Controller

The following section describes the EDAC DT node binding.

Required properties:

- compatible: Should contain "hisilicon,ddrc-edac".
- reg: Physical base address of the ddrc driver and
length of memory mapped region.

Optional properties:
- interrupt-parent: the interrupt parent of this device.
- interrupts: should contain 1 DMC event irq and 1 RASC irq event
Example:
	edacmc@60340000 {
	compatible = "hisilicon,ddrc-edac";
	reg = <0x0 0x60340000 0x0 0x10000>;
	interrupts =	<0 296 4>,
			<0 297 4>;
	};


Hisi HCCS Home Agent EDAC node

EDAC node is defined to describe on-chip error detection and correction of
HCCS Home Agent EDAC.

The follow error types are supported:

  HCCS Home Agent	- Home Agent of ddrc and Ring Bus

The following section describes the EDAC DT node binding.

Required properties:

- compatible: Should contain "hisilicon,hha-edac" for hip05
and Should contain "hisilicon,hi1382-hha-edac" for 1382.
- reg: Physical base address of the hha driver and
length of memory mapped region.
- djtag: phandle, specifies a reference to a node
representing a djtag device.

Optional properties:
- interrupt-parent: the interrupt parent of this device.
- interrupts: should contain 2 hha irq event
Example:
	edac_hha_a {
		compatible = "hisilicon,hha-edac";
		reg = <0x0 0x40010000 0x0 0x10000>;
		interrupt-parent = <&mbigen_pa>;
		interrupts =	<147 4>,
				<148 4>;
		djtag = <&djtag0>;
	};


Hisi Last Level Cache EDAC node

EDAC node is defined to describe on-chip error detection and correction of
Last Level Cache.

The follow error types are supported:

  cache (L3)	- Processor L3 cache

The following section describes the EDAC DT node binding.

Required properties:

- compatible: Should contain "hisilicon,llc-edac" for hip05
and Should contain "hisilicon,hi1382-llc-edac" for 1382.
- reg: Physical base address of the llc driver and
length of memory mapped region.
- djtag: phandle, specifies a reference to a node
representing a djtag device.

Optional properties:
- interrupt-parent: the interrupt parent of this device.
- interrupts: should contain 4 llc irq event
Example:
	edac_llc_a {
		compatible = "hisilicon,llc-edac";
		reg = <0x0 0x40010000 0x0 0x10000>;
		interrupt-parent = <&mbigen_pa>;
		interrupts =	<141 4>,
				<142 4>,
				<143 4>,
				<144 4>;
		djtag = <&djtag0>;
	};


Hisi Protocol Adapter EDAC node

EDAC node is defined to describe on-chip error detection and correction of
Protocol Adapter.

The follow error types are supported:

  Protocol Adapter	- Adapter Between Hydra and Skyros

The following section describes the EDAC DT node binding.

Required properties:

- compatible: Should contain "hisilicon,pa-edac".
- reg: Physical base address of the pa driver and
length of memory mapped region.
- djtag: phandle, specifies a reference to a node
representing a djtag device.

Optional properties:
- interrupt-parent: the interrupt parent of this device.
- interrupts: should contain pa irq event
Example:
	edac_pa_nimbus1 {
		compatible = "hisilicon,pa-edac";
		reg = <0x0 0xD0000000 0x0 0x10000>;
		interrupt-parent = <&mbigen_p0_alg>;
		interrupts =	<0x40b1a 15 14 6>,
				<0x40b1a 15 15 6>,
				<0x40b1a 15 16 6>,
				<0x40b1a 15 17 6>,
				<0x40b1a 15 18 6>,
				<0x40b1a 15 19 6>,
				<0x40b1a 15 20 6>,
				<0x40b1a 15 21 6>,
				<0x40b1a 15 22 6>,
				<0x40b1a 15 23 6>,
				<0x40b1a 15 24 6>,
				<0x40b1a 15 25 6>,
				<0x40b1a 15 26 6>,
				<0x40b1a 15 27 6>,
				<0x40b1a 15 28 6>;
		djtag = <&djtag2>;
	};


Hisi Skyros Link Layer Controller EDAC node

EDAC node is defined to describe on-chip error detection and correction of
Skyros Link Layer Controller.

The follow error types are supported:

  Skyros Link Layer Controller	- Toterm Skyros Protocol Adapter
  Skyros Link Layer Controller	- Nimbus Skyros Protocol Adapter

The following section describes the EDAC DT node binding.

Required properties:

- compatible: Should contain "hisilicon,sllcc-edac" for hip05 Toterm
and Should contain "hisilicon,sllcn-edac" for hip05 Nimbus
and Should contain "hisilicon,hi1382-sllcc-edac" for 1382 Toterm.
- reg: Physical base address of the roce driver and
length of memory mapped region.
- djtag: phandle, specifies a reference to a node
representing a djtag device.

Optional properties:
- interrupt-parent: the interrupt parent of this device.
- interrupts: should contain all sllc irq event
Example:
	edac_sllc_a {
		compatible = "hisilicon,sllcc-edac";
		reg = <0x0 0x40000000 0x0 0x10000>;
		interrupt-parent = <&mbigen_pa>;
		interrupts =	<172 4>,
				<173 4>,
				<174 4>,
				<175 4>;
		djtag = <&djtag0>;
	};
	edac_sllc_n {
		compatible = "hisilicon,sllcn-edac";
		reg = <0x0 0xD0000000 0x0 0x10000>;
		interrupt-parent = <&mbigen_p0_alg>;
		interrupts =	<0x40b1a 15 14 6>,
				<0x40b1a 15 15 6>,
				<0x40b1a 15 16 6>,
				<0x40b1a 15 17 6>,
				<0x40b1a 15 18 6>,
				<0x40b1a 15 19 6>,
				<0x40b1a 15 20 6>,
				<0x40b1a 15 21 6>,
				<0x40b1a 15 22 6>,
				<0x40b1a 15 23 6>,
				<0x40b1a 15 24 6>,
				<0x40b1a 15 25 6>,
				<0x40b1a 15 26 6>,
				<0x40b1a 15 27 6>,
				<0x40b1a 15 28 6>;
		djtag = <&djtag2>;
	};


Hisi System Memory Management Unit EDAC node

EDAC node is defined to describe on-chip error detection and correction of
Protocol Adapter.

The follow error types are supported:

  System Memory Management Unit	- System Address Translation

The following section describes the EDAC DT node binding.

Required properties:

- compatible: Should contain "hisilicon,smmu-edac".
- reg: Physical base address of the smmu driver and
length of memory mapped region.

Optional properties:
- interrupt-parent: the interrupt parent of this device.
- interrupts: should contain smmu irq event
Example:
	edac_smmu_dsa {
		compatible = "hisilicon,hi-edac";
		reg = <0x0 0xC0040000 0x0 0x20000>;
		interrupt-parent = <&mbigen_dsa>;
		interrupts =	<0x40b20 3 78 6>,
				<0x40b20 3 79 6>,
				<0x40b20 3 80 6>;
	};
```

## Documentation/devicetree/bindings/infiniband/hisilicon-hns-roce.txt
```
HiSilicon RoCE DT description

HiSilicon RoCE engine is a part of network subsystem.
It works depending on other part of network wubsytem, such as, gmac and
dsa fabric.

Additional properties are described here:

Required properties:
- compatible: Should contain "hisilicon,hns-roce-v1".
- reg: Physical base address of the roce driver and
length of memory mapped region.
- eth-handle: phandle, specifies a reference to a node
representing a ethernet device.
- dsaf-handle: phandle, specifies a reference to a node
representing a dsaf device.
- #address-cells: must be 2
- #size-cells: must be 2
Optional properties:
- dma-coherent: Present if DMA operations are coherent.
- interrupt-parent: the interrupt parent of this device.
- interrupts: should contain 32 completion event irq,1 async event irq
and 1 event overflow irq.
Example:
	infiniband@c4000000 {
			compatible = "hisilicon,hns-roce-v1";
			reg = <0x0 0xc4000000 0x0 0x100000>;
			dma-coherent;
			eth-handle = <&eth2 &eth3 &eth4 &eth5 &eth6 &eth7>;
			dsaf-handle = <&soc0_dsa>;
			#address-cells = <2>;
			#size-cells = <2>;
			interrupt-parent = <&mbigen_dsa>;
			interrupts = <0x40B1E 34 18 6>,
					<0x40B1E 34 19 6>,
					<0x40B1E 34 20 6>,
					<0x40B1E 34 21 6>,
					<0x40B1E 34 22 6>,
					<0x40B1E 34 23 6>,
					<0x40B1E 34 24 6>,
					<0x40B1E 34 25 6>,
					<0x40B1E 34 26 6>,
					<0x40B1E 34 27 6>,
					<0x40B1E 34 28 6>,
					<0x40B1E 34 29 6>,
					<0x40B1E 34 30 6>,
					<0x40B1E 34 31 6>,
					<0x40B1E 34 32 6>,
					<0x40B1E 34 33 6>,
					<0x40B1E 34 34 6>,
					<0x40B1E 34 35 6>,
					<0x40B1E 34 36 6>,
					<0x40B1E 34 37 6>,
					<0x40B1E 34 38 6>,
					<0x40B1E 34 39 6>,
					<0x40B1E 34 40 6>,
					<0x40B1E 34 41 6>,
					<0x40B1E 34 42 6>,
					<0x40B1E 34 43 6>,
					<0x40B1E 34 44 6>,
					<0x40B1E 34 45 6>,
					<0x40B1E 34 46 6>,
					<0x40B1E 34 47 6>,
					<0x40B1E 34 48 6>,
					<0x40B1E 34 49 6>,
					<0x40B1E 34 50 6>,
					<0x40B1E 34 51 6>;
		};
```

## Documentation/devicetree/bindings/mtd/hip05_nfc.txt
```
Hisilicon Hip05 Soc NAND controller DT binding

Required properties:

- compatible:          Should be "hisilicon,hip05-nfc".
- reg:                 The first contains base physical address and size of
                       NAND controller's registers. The second contains base
                       physical address and size of NAND controller's buffer.


Example:

	nand: nand@68010000 {
		compatible = "hisilicon,hip05-nfc";
		reg = <0x0 0x68010000 0x0 0x10000>, <0x0 0x68020000 0x0 0x10000>;
	};
```
